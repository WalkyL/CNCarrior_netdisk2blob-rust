## examples/esp32-s3-client-only/main/Kconfig.projbuild
```kconfig
# SPDX-License-Identifier: LicenseRef-CCBG-Commercial
# Copyright (c) 2026 walky

menu "CCBG ESP32-S3 Client-Only Demo"

config CCBG_DEMO_AUTO_RUN
    bool "Run the CCBG demo from app_main"
    default y

config CCBG_GATEWAY_HOST
    string "CCBG gateway host and port"
    default "192.168.1.43:61080"

config CCBG_S3_REGION
    string "CCBG S3 region"
    default "us-east-1"

config CCBG_S3_ACCESS_KEY
    string "CCBG S3 access key"
    default "ccbg-esp32"

config CCBG_S3_SECRET_KEY
    string "CCBG S3 secret key"
    default "change-me"

config CCBG_DEMO_BUCKET
    string "Demo bucket"
    default "root"

config CCBG_DEMO_KEY
    string "Demo object key"
    default "esp32-s3/demo.txt"

endmenu
```
